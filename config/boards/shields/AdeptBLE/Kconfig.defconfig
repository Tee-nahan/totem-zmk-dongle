## config/boards/shields/AdeptBLE/Kconfig.defconfig
```kconfig
if SHIELD_ADEPTBLE

config ZMK_KEYBOARD_NAME
    default "AdeptBLE"

config SPI
    default y

endif
```

## config/boards/shields/totem/Kconfig.defconfig
```kconfig
if SHIELD_TOTEM_CENTRAL || SHIELD_TOTEM_LEFT || SHIELD_TOTEM_RIGHT

config ZMK_SPLIT
    default y

endif # SHIELD_TOTEM_CENTRAL || SHIELD_TOTEM_LEFT || SHIELD_TOTEM_RIGHT


if SHIELD_TOTEM_CENTRAL

config ZMK_KEYBOARD_NAME
    default "TOTEM"

config ZMK_SPLIT_ROLE_CENTRAL
    default y

# 3 peripherals: totem_left + totem_right + AdeptBLE
config ZMK_SPLIT_BLE_CENTRAL_PERIPHERALS
    default 3

# 3 peripherals + 5 BLE host profiles
config BT_MAX_CONN
    default 8

config BT_MAX_PAIRED
    default 8

endif # SHIELD_TOTEM_CENTRAL


if SHIELD_TOTEM_LEFT

config ZMK_KEYBOARD_NAME
    default "TOTEM"

endif # SHIELD_TOTEM_LEFT
```

## config/west.yml
```yaml
manifest:
  remotes:
    - name: zmkfirmware
      url-base: https://github.com/zmkfirmware
    - name: englmaxi
      url-base: https://github.com/englmaxi
    - name: tee-nahan
      url-base: https://github.com/Tee-nahan
    - name: badjeff
      url-base: https://github.com/badjeff
  projects:
    - name: zmk
      remote: tee-nahan
      revision: main
      import: app/west.yml
    - name: zmk-dongle-display
      remote: tee-nahan
      revision: 94d3607529c5896b0f7e6099ed32fb72155f0298
    - name: zmk-pmw3610-driver
      remote: badjeff
      revision: main
  self:
    path: config
```
